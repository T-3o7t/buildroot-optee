## configs/qemu_riscv64_virt_optee_defconfig
```kconfig
BR2_riscv=y
BR2_RISCV_ISA_RVC=y
BR2_TOOLCHAIN_EXTERNAL=y
BR2_SYSTEM_DHCP="eth0"
BR2_ROOTFS_OVERLAY="board/qemu/riscv64-virt-optee/rootfs_overlay"
BR2_ROOTFS_POST_BUILD_SCRIPT="board/qemu/post-image.sh"
BR2_ROOTFS_POST_IMAGE_SCRIPT="support/scripts/genimage.sh"
BR2_ROOTFS_POST_BUILD_SCRIPT_ARGS="$(BR2_DEFCONFIG)"
BR2_ROOTFS_POST_IMAGE_SCRIPT_ARGS="-c board/qemu/riscv64-virt-optee/genimage_sdcard.cfg"
BR2_LINUX_KERNEL=y
BR2_LINUX_KERNEL_CUSTOM_TARBALL=y
BR2_LINUX_KERNEL_CUSTOM_TARBALL_LOCATION="https://gitlab.com/riseproject/riscv-optee/linux/-/archive/6664df2de659377a68487eec886f1d2c7f3706d4/linux-dev-optee-mpxy-v8.tar.gz"
BR2_LINUX_KERNEL_USE_ARCH_DEFAULT_CONFIG=y
BR2_LINUX_KERNEL_DTS_SUPPORT=y
BR2_LINUX_KERNEL_INTREE_DTS_NAME="qemu/qemu_rv64_virt_domain"
BR2_LINUX_KERNEL_INSTALL_TARGET=y
BR2_PACKAGE_OPTEE_EXAMPLES=y
BR2_PACKAGE_OPTEE_TEST=y
BR2_TARGET_ROOTFS_EXT2=y
BR2_TARGET_ROOTFS_EXT2_SIZE="260M"
BR2_TARGET_OPTEE_OS=y
BR2_TARGET_OPTEE_OS_CUSTOM_TARBALL=y
BR2_TARGET_OPTEE_OS_CUSTOM_TARBALL_LOCATION="https://gitlab.com/riseproject/riscv-optee/optee_os/-/archive/6122a759c180ae56159d1aad8bbca5fb04d948aa/optee_os-dev-optee-mpxy-v8.tar.gz"
BR2_TARGET_OPTEE_OS_NEEDS_PYTHON_CRYPTOGRAPHY=y
BR2_TARGET_OPTEE_OS_PLATFORM="virt"
BR2_TARGET_OPTEE_OS_ADDITIONAL_VARIABLES="ARCH=riscv DEBUG=1 CFG_TEE_CORE_NB_CORE=2 CFG_NUM_THREADS=2 CFG_TEE_CORE_LOG_LEVEL=4 CFG_TEE_TA_LOG_LEVEL=4 CFG_UNWIND=y CFG_IN_TREE_EARLY_TAS=trusted_keys/f04a0fe7-1f5d-4b9b-abf7-619b85b4ce8c CFG_SEMIHOSTING_CONSOLE=y CFG_SEMIHOSTING_CONSOLE_FILE=NULL CFG_TEE_CORE_DEBUG=y CFG_16550_UART=n CFG_RISCV_PLIC=n CFG_TDDRAM_START=0xF1000000 CFG_TDDRAM_SIZE=0x01000000"
BR2_TARGET_OPTEE_OS_CORE_IMAGES="tee.bin"
BR2_TARGET_OPENSBI=y
BR2_TARGET_OPENSBI_CUSTOM_TARBALL=y
BR2_TARGET_OPENSBI_CUSTOM_TARBALL_LOCATION="https://gitlab.com/riseproject/riscv-optee/opensbi/-/archive/bd1f41f8ded0600aba35a6fc32d382aae9416640/opensbi-dev-optee-mpxy-v8.tar.gz"
BR2_TARGET_OPENSBI_PLAT="generic"
BR2_TARGET_UBOOT=y
BR2_TARGET_UBOOT_BUILD_SYSTEM_KCONFIG=y
BR2_TARGET_UBOOT_CUSTOM_TARBALL=y
BR2_TARGET_UBOOT_CUSTOM_TARBALL_LOCATION="https://gitlab.com/riseproject/riscv-optee/u-boot/-/archive/32bdb252fab83028768a269fb304b9356547ccbd/u-boot-dev-optee-mpxy-v5.tar.gz"
BR2_TARGET_UBOOT_BOARD_DEFCONFIG="qemu-riscv64_spl"
BR2_TARGET_UBOOT_NEEDS_GNUTLS=y
BR2_TARGET_UBOOT_NEEDS_OPTEE_TEE=y
BR2_TARGET_UBOOT_NEEDS_OPTEE_TEE_BIN=y
BR2_TARGET_UBOOT_NEEDS_OPENSBI=y
BR2_TARGET_UBOOT_FORMAT_CUSTOM=y
BR2_TARGET_UBOOT_FORMAT_CUSTOM_NAME="u-boot.itb"
BR2_TARGET_UBOOT_SPL=y
BR2_TARGET_UBOOT_SPL_NAME="spl/u-boot-spl"
BR2_PACKAGE_HOST_GENIMAGE=y
BR2_PACKAGE_HOST_QEMU=y
BR2_PACKAGE_HOST_QEMU_SYSTEM_MODE=y
```

## package/gcc-target/Config.in
```kconfig
config BR2_PACKAGE_GCC_TARGET
	bool "gcc (native compiler on the target)"
	depends on BR2_TOOLCHAIN_BUILDROOT # same gcc sources / tuple
	depends on BR2_USE_WCHAR
	depends on BR2_TOOLCHAIN_HAS_THREADS
	depends on BR2_USE_MMU
	select BR2_PACKAGE_BINUTILS
	select BR2_PACKAGE_BINUTILS_TARGET
	select BR2_PACKAGE_GMP
	select BR2_PACKAGE_MPFR
	select BR2_PACKAGE_MPC
	help
	  A native C/C++ compiler running ON the target (a Canadian
	  cross of the same gcc used for the internal toolchain).

	  This lets you compile programs on the device itself.  It
	  pulls in binutils (as/ld) on the target, and a post-build
	  script must install the libc headers and startup objects
	  (see board/qemu/riscv64-virt-optee-tpm/post-build.sh).

	  Note: this is a large package and a long build.

comment "gcc-target needs a buildroot (internal) toolchain w/ wchar, threads"
	depends on BR2_USE_MMU
	depends on !BR2_TOOLCHAIN_BUILDROOT || !BR2_USE_WCHAR || !BR2_TOOLCHAIN_HAS_THREADS
```

## package/man-pages/Config.in
```kconfig
config BR2_PACKAGE_MAN_PAGES
	bool "man-pages"
	help
	  The Linux man-pages project: manual pages for the Linux
	  kernel and C library interfaces (sections 2, 3, 4, 5, 7, 8).
	  Installs the roff sources to /usr/share/man; a viewer such
	  as mandoc is needed to read them.

	  Note: Buildroot removes /usr/share/man from the target at
	  target-finalize, so pages must be put back by a post-build
	  script (see board/qemu/riscv64-virt-optee-tpm/post-build.sh).

	  https://www.kernel.org/doc/man-pages/
```

## package/mandoc/Config.in
```kconfig
config BR2_PACKAGE_MANDOC
	bool "mandoc"
	depends on BR2_USE_MMU # fork()
	select BR2_PACKAGE_ZLIB
	help
	  mandoc is a suite of tools compiling mdoc(7) and man(7),
	  the roff macro languages of choice for manual pages. It
	  provides a complete, self-contained man(1) implementation
	  (man, apropos, whatis, makewhatis, mandoc, demandoc, soelim)
	  without needing groff.

	  Note: Buildroot removes /usr/share/man from the target at
	  target-finalize, so pages must be put back by a post-build
	  script (see board/qemu/riscv64-virt-optee-tpm/post-build.sh)
	  or installed elsewhere in the manpath.

	  https://mandoc.bsd.lv/
```

## package/mandoc/Config.in.host
```kconfig
config BR2_PACKAGE_HOST_MANDOC
	bool "host mandoc"
	help
	  mandoc for the host: makewhatis(8) is used to build the
	  target's mandoc.db (apropos/whatis index) at image
	  build time, plus mandoc(1) to preformat or check pages.

	  https://mandoc.bsd.lv/
```

## package/optee-selftest/Config.in
```kconfig
config BR2_PACKAGE_OPTEE_SELFTEST
	bool "optee-selftest (custom TA + host test app)"
	depends on BR2_TARGET_OPTEE_OS
	depends on BR2_TOOLCHAIN_HAS_THREADS # optee-client
	depends on !BR2_STATIC_LIBS # optee-client
	depends on BR2_USE_MMU # optee-client
	select BR2_PACKAGE_OPTEE_CLIENT
	select BR2_TARGET_OPTEE_OS_SDK
	help
	  A small custom Trusted Application and its host client used to
	  verify the OP-TEE stack end to end: value passing, an in-TEE
	  SHA-256 (GlobalPlatform crypto API) checked against the FIPS
	  test vector, and the secure-world TRNG.

	  Installs the TA as /lib/optee_armtz/<uuid>.ta and the client as
	  /usr/bin/optee_selftest (prints PASS/FAIL per check).

comment "optee-selftest needs a toolchain w/ threads, dynamic library"
	depends on BR2_TARGET_OPTEE_OS
	depends on BR2_USE_MMU
	depends on !BR2_TOOLCHAIN_HAS_THREADS || BR2_STATIC_LIBS
```
